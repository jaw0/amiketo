/*
  Copyright (c) 2015
  Author: Jeff Weisberg <jaw @ tcp4me.com>
  Created: 2015-Apr-09 23:10 (EDT)
  Function: startup screen

*/

extern "C" {
#include <conf.h>
#include <proc.h>
#include <ioctl.h>
#include <error.h>
#include <stm32.h>
#include <userint.h>
};

#include "gfxdpy.h"

extern "C" void splash( GFXdpy* );
extern "C" int was_rtc_wakeup(void);
extern "C" void ui_pause(void), ui_resume(void);

static uint8_t image[] = {

// compressed 128x64 startup screen
255, 255, 255, 255, 255, 255, 255, 114, 8, 255, 113, 9, 255, 111, 1,
113, 11, 125, 1, 255, 8, 2, 19, 3, 28, 2, 36, 2, 41, 1, 49, 2, 61, 6,
70, 7, 79, 4, 110, 6, 121, 6, 255, 9, 2, 20, 3, 27, 4, 36, 2, 41, 2,
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68, 1, 72, 1, 75, 1, 77, 1, 255, 44, 15, 255,

};


void
splash( GFXdpy *dpy ){
    short x=0, y=0;
    short i=0, l;

    dpy->clear_screen();
    if( was_rtc_wakeup() ){
        dpy->flush();
        return;
    }
    // RSN - multiple screen sizes? color?

    while( y < 64 && i < sizeof(image) ){
        x = image[i++];
        if( x == 0xFF ){
            x = 0;
            y ++;
            continue;
        }
        l = image[i++];
        for( ; l; l--){
            dpy->set_pixel(x, y, 0xFFFFFF);
            x++;
        }
    }

    dpy->set_font("6x10");

    // fill in details
    // RSN - these should come from conf
    dpy->set_pos(6, 30);
    dpy->puts("STM32F411");

    dpy->set_pos(62, 45);
    dpy->puts("Rev. 0");

    dpy->set_pos(80,55);
    dpy->puts("/2015-04");

    dpy->flush();
}

#define D 48
#define S 32
void inline
saver_step_draw(GFXdpy *g, int i, int color){
    short x,y;

    for(x=i-D; x<g->width; x+=S)
        g->line(x,0, x+D,g->height-1, color, 0xf0f0f0f0);

    for(x=-i; x<g->width+D; x+=S)
        g->line(x,0, x-D, g->height-1, color, 0xFF00FF00);
}


extern "C" void
screensaver_step(void){
    GFXdpy *g = (GFXdpy*)fioctl(STDOUT, IOC_GFXDPY, 0);
    if(!g) return;
    static short i = 0;

    saver_step_draw(g, i, 0xFFFFFF);
    g->flush();
    saver_step_draw(g, i, 0);

    i = (i+1) % S;
}


extern "C"
DEFUN(gfxtest, "test gfx")
{
    FILE *f   = fopen("dev:oled0", "w");
    GFXdpy *g = (GFXdpy*)fioctl(f, IOC_GFXDPY, 0);
    if(!g) return 0;

    ui_pause();
    g->clear_screen();

    g->line(8,32, 120,32, 0xFFFFFF, 0xF0F0F0F0);
    g->line(8,32, 120,60, 0xFFFFFF, 0xF0F0F0F0);
    g->rect(16,16, 48,24, 0xFFFFFF, 0xF0F0F0F0);
    g->rect_filled(80,16, 100,64, 0xFFFFFF);

    g->flush();
    sleep(2);

    ui_resume();
    return 0;
}
